## conf/machine/sl2619nand.conf
```bitbake
#@TYPE: Machine
#@NAME: sl2619nand
#@DESCRIPTION: Machine configuration for the SL2619 SoC

require conf/machine/include/arm/armv8-2a/tune-cortexa55.inc

include conf/machine/include/syna-tiny.inc
include conf/machine/include/syna-sdk.inc

MACHINEOVERRIDES =. "sl2619:klamath:"

IMAGE_CLASSES:remove = "image_synaimg"
IMAGE_CLASSES += "image_synanandimg"
IMAGE_FSTYPES = "synanandimg"

SYNA_SDK_CONFIG_NAME ?= "sl2619_nand_${DISTRO_CONFIG}_aarch64_rdk"
SYNA_SDK_CONFIG_FILE ?= "${SYNA_SDK_CONFIG_NAME}_defconfig"
SYNA_SDK_PT_FILE = "nand.pt"
SYNA_SDK_FLASH_TYPE_CFG_FILE = "flash_type.cfg"
SYNA_SDK_FASTLOGO_IMG = ""
UBOOT_MACHINE ?= "klamath_nand_suboot_defconfig"
UBOOT_DTS_FILE ?= "klamath-rdk-nand.dtb"
SYNA_KERNEL_CONFIG_FILE ?= "sl261x_defconfig"
SYNA_KERNEL_DTS_FILE ?= "synaptics/sl2619-nand-rdk.dtb"
SYNA_KERNEL_DTBO_FILE ?= "synaptics/sl261x-haier-panel-overlay.dtbo \
                          synaptics/sl261x-ws-1080p-panel-overlay.dtbo \
                          synaptics/sl261x-ws-panel-overlay.dtbo \
                          synaptics/sl261x-nand-overlay.dtbo"

# WPE buffer size for media (important for youtube in 4K)
# 30MB for 1GB DRAM systems, 90MB for 2GB DRAM systems
SYNA_MEDIASOURCE_VIDEO_BUFFER_SIZE = "90"
# WPE RAM size limits, 192/200 for 1GB DRAM systems, 320/340 for 2GB DRAM systems
# (important to prevent memory pressure)
SYNA_WPE_RAM_SIZE = "320"
SYNA_WPE_WEB_PROCESS_RAM_SIZE = "340"

PREFERRED_VERSION_linux-syna:sl2619nand = "6.12.62"
PREFERRED_VERSION_linux-firmware-syna:sl2619nand = "6.12.62"

PREFERRED_PROVIDER_u-boot-fw-utils:sl2619nand = "libubootenv"

#Remove packages to reduce rootfs size to fit small disk
# sysvinit needs 27M less than systemd
#INIT_MANAGER = "sysvinit"

# reduce 49M
# /usr/lib/systemd/network/80-wired.network is needed for ethernet up
# which is included in systemd-conf
NO_RECOMMENDATIONS = "1"
IMAGE_INSTALL:append:sl2619nand = " systemd-conf"

# Below files are needed for systemctl suspend
# /usr/lib/systemd/system/systemd-suspend.service
# /usr/lib/systemd/systemd-sleep
# /usr/lib/systemd/sleep.target
# /usr/bin/systemd-tty-ask-password-agent
# which are included in systemd-extra-utils
IMAGE_INSTALL:append:sl2619nand = " systemd-extra-utils"

GLIBC_GENERATE_LOCALES = ""
IMAGE_LINGUAS = "en-us"
IMAGE_FEATURES:remove:sl2619nand = "package-management ssh-server-dropbear tools-debug"
DISTRO_FEATURES:sl2619nand = "pci ipv4 ipv6 usbhost usbgadget wifi acl alsa debuginfod ext2 pcmcia xattr nfs zeroconf vfat seccomp bluetooth"
IMAGE_INSTALL:remove:sl2619nand = "packagegroup-core-tools-debug packagegroup-core-ssh-openssh gdbserver curl v4l-utils alsa-utils \
  synasdk-syna-settings-framework wget vim wlan-connect ethtool protobuf libdrm-tests opensc libgpiod libgpiod-tools iperf2 iperf3 \
  net-tools tcpdump pciutils iputils zip networkmanager networkmanager-nmcli modemmanager evtest bridge-utils i2c-tools \
  ${WAYLAND_PACKAGES} ${XORG_MATCHBOX_DESKTOP} synasdk-v4l2isp-test synasdk-v4l2isp-qtapp \
  ${TORQ_PACKAGES} ${GST_PACKAGES} ${GPU_RELATED_PACKAGES} ${NPU_RELATED_PACKAGES} ${QT_PACKAGES} \
  ${SYNA_PLAYER_PACKAGES} qtwayland ${MULTIMEDIA_GPU_RELATED_PACKAGES}"

# swupdate related packages, need 11M
# swupdate dependend on systemd
IMAGE_INSTALL:remove:sl2619nand += " swupdate swupdate-client swupdate-progress swupdate-tools swupdate-tools-hawkbit swupdate-tools-ipc swu-conf \
  openssh openssh-sshd openssh-scp util-linux-lsblk util-linux udev udev-extraconf chrony rescue-support"

# adb related packages, need 8M
#IMAGE_INSTALL:remove:sl2619nand += " android-tools android-tools-adbd ncm-gadget-conf-configfs"

# syna-wifi-tools, need 18M
#IMAGE_INSTALL:remove:sl2619nand += " syna-wifi-tools"

PACKAGE_EXCLUDE += " util-linux-look util-linux-rename util-linux-script util-linux-scriptlive util-linux-ul util-linux-waitpid util-linux-wdctl util-linux-whereis util-linux-write"
TOOLCHAIN_TARGET_TASK:remove:sl2619nand = "synasdk-synap-runtime-staticdev"
```

## conf/machine/sl2619xspi.conf
```bitbake
#@TYPE: Machine
#@NAME: sl2619xspi
#@DESCRIPTION: Machine configuration for the SL2619 SoC

require conf/machine/include/arm/armv8-2a/tune-cortexa55.inc

include conf/machine/include/syna-tiny.inc
include conf/machine/include/syna-sdk.inc

IMAGE_CLASSES:remove = "image_synaimg"
IMAGE_CLASSES += "image_synaspiimg"
IMAGE_FSTYPES = "synaspiimg"

MACHINEOVERRIDES =. "klamath:"

SYNA_SDK_CONFIG_NAME ?= "sl2619_xspi_${DISTRO_CONFIG}_aarch64_rdk"
SYNA_SDK_CONFIG_FILE ?= "${SYNA_SDK_CONFIG_NAME}_defconfig"
SYNA_SDK_PT_FILE = "xspi.pt"
SYNA_SDK_FLASH_TYPE_CFG_FILE = ""
SYNA_SDK_FLASH_ATTR = "ISSI-MX-1BIT"
SYNA_SDK_FASTLOGO_IMG = ""
UBOOT_MACHINE ?= "klamath_spi_suboot_defconfig"
UBOOT_DTS_FILE ?= "klamath-rdk.dtb"
SYNA_KERNEL_CONFIG_FILE ?= "sl261x_sizelimit_defconfig"
SYNA_KERNEL_DTS_FILE ?= "synaptics/sl2619-rdk.dtb"

PREFERRED_VERSION_linux-syna:sl2619xspi = "6.12.62"
PREFERRED_VERSION_linux-firmware-syna:sl2619xspi = "6.12.62"

PREFERRED_PROVIDER_u-boot-fw-utils:sl2619xspi = "libubootenv"

BBMULTICONFIG = "initramfscfg"
INITRAMFS_MULTICONFIG = "initramfscfg"
INITRAMFS_DEPLOY_DIR_IMAGE = "${TOPDIR}/tmp-initramfscfg/deploy/images/${MACHINE}"
```

## setup/conf/bblayers.conf.sample
```bitbake
# POKY_BBLAYERS_CONF_VERSION is increased each time build/conf/bblayers.conf
# changes incompatibly
POKY_BBLAYERS_CONF_VERSION = "2"

BBPATH = "${TOPDIR}"
BBFILES ?= ""

BBLAYERS ?= " \
  ##OEROOT##/meta \
  ##OEROOT##/meta-poky \
  ##OEROOT##/meta-yocto-bsp \
  ##OEROOT##/../meta-openembedded/meta-oe \
  ##OEROOT##/../meta-openembedded/meta-python \
  ##OEROOT##/../meta-openembedded/meta-multimedia \
  ##OEROOT##/../meta-openembedded/meta-networking \
  ##OEROOT##/../meta-openembedded/meta-filesystems \
  ##OEROOT##/../meta-browser/meta-chromium \
  ##OEROOT##/../meta-clang \
  ##OEROOT##/../meta-lts-mixins \
  ##OEROOT##/../meta-qt5 \
  ##OEROOT##/../meta-synaptics \
  ##OEROOT##/../meta-swupdate \
  ##OEROOT##/../meta-virtualization \
  "
```

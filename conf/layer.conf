## conf/layer.conf
```bitbake
# We have a conf and classes directory, append to BBPATH
BBPATH .= ":${LAYERDIR}"

# We have recipes directories containing .bb and .bbappend files, add to BBFILES
BBFILES += "${LAYERDIR}/recipes*/*/*.bb ${LAYERDIR}/recipes*/*/*.bbappend"

BBFILE_COLLECTIONS += "meta-synaptics"
BBFILE_PATTERN_meta-synaptics := "^${LAYERDIR}/"
BBFILE_PRIORITY_meta-synaptics = "9"

LAYERDEPENDS_meta-synaptics = "core"

LAYERSERIES_COMPAT_meta-synaptics = "scarthgap"

BBFILES_DYNAMIC += " \
    rdk:${LAYERDIR}/dynamic-layers/rdk/recipes-*/*/*.bb \
    rdk:${LAYERDIR}/dynamic-layers/rdk/recipes-*/*/*.bbappend \
    \
    video:${LAYERDIR}/dynamic-layers/rdk-video/recipes-*/*/*.bb \
    video:${LAYERDIR}/dynamic-layers/rdk-video/recipes-*/*/*.bbappend \
    \
    openembedded-layer:${LAYERDIR}/dynamic-layers/openembedded-layer/*/*/*.bb \
    openembedded-layer:${LAYERDIR}/dynamic-layers/openembedded-layer/*/*/*.bbappend \
    \
    networking-layer:${LAYERDIR}/dynamic-layers/networking-layer/*/*/*.bb \
    networking-layer:${LAYERDIR}/dynamic-layers/networking-layer/*/*/*.bbappend \
    \
    multimedia-layer:${LAYERDIR}/dynamic-layers/multimedia-layer/*/*/*.bb \
    multimedia-layer:${LAYERDIR}/dynamic-layers/multimedia-layer/*/*/*.bbappend \
    \
    qt5-layer:${LAYERDIR}/dynamic-layers/qt5-layer/*/*/*.bb \
    qt5-layer:${LAYERDIR}/dynamic-layers/qt5-layer/*/*/*.bbappend \
    \
    qt6-layer:${LAYERDIR}/dynamic-layers/qt6-layer/*/*/*.bb \
    qt6-layer:${LAYERDIR}/dynamic-layers/qt6-layer/*/*/*.bbappend \
    \
    swupdate:${LAYERDIR}/dynamic-layers/swupdate-layer/*/*/*.bb \
    swupdate:${LAYERDIR}/dynamic-layers/swupdate-layer/*/*/*.bbappend \
    \
    chromium-browser-layer:${LAYERDIR}/dynamic-layers/chromium-browser-layer/*/*/*.bb \
    chromium-browser-layer:${LAYERDIR}/dynamic-layers/chromium-browser-layer/*/*/*.bbappend \
    \
    virtualization-layer:${LAYERDIR}/dynamic-layers/virtualization-layer/*/*/*.bb \
    virtualization-layer:${LAYERDIR}/dynamic-layers/virtualization-layer/*/*/*.bbappend \
    \
    meta-python:${LAYERDIR}/dynamic-layers/meta-python/*/*/*.bb \
    meta-python:${LAYERDIR}/dynamic-layers/meta-python/*/*/*.bbappend \
	\
    meta-aws:${LAYERDIR}/dynamic-layers/aws-layer/recipes-*/*/*.bb \
    meta-aws:${LAYERDIR}/dynamic-layers/aws-layer/recipes-*/*/*.bbappend \
"

ASTRA_VERSION = "scarthgap_6.12_v2.5.0"
SYNAP_VERSION = "3.0"
PREFERRED_VERSION_meson-native = "1.3.1"
include syna-sources-git.conf
```

## conf/machine/include/syna-sdk.inc
```bitbake
#/*******************************************************************************
#*
#*             Copyright 2020, Beechwoods Software, Inc.
#*
#*******************************************************************************/

SYNA_SDK_NAME = "syna"
SYNA_SDK_BUILD = "-release"
SYNA_SDK_PT_FILE = "emmc.pt"
SYNA_SDK_FLASH_ATTR = ""
SYNA_SDK_FASTLOGO_IMG = "fastlogo.subimg.gz"
DISTRO_CONFIG= "${@d.getVar('DISTRO').replace('-', '_')}"
```

## conf/machine/include/syna-sl261x.inc
```bitbake
include conf/machine/include/syna-tiny.inc

# Synaptics BSP default providers
PREFERRED_PROVIDER_virtual/libgl ?= "synasdk-gpu-mali"
PREFERRED_PROVIDER_virtual/egl ?= "synasdk-gpu-mali"
PREFERRED_PROVIDER_virtual/libgles1 ?= "synasdk-gpu-mali"
PREFERRED_PROVIDER_virtual/libgles2 ?= "synasdk-gpu-mali"
PREFERRED_PROVIDER_virtual/libgles3 ?= "synasdk-gpu-mali"
PREFERRED_PROVIDER_virtual/libgbm ?= "synasdk-gpu-mali"
MACHINE_EXTRA_RRECOMMENDS += "synasdk-gpu-mali"
MACHINE_ESSENTIAL_EXTRA_RDEPENDS += "kernel-devicetree"
```

## conf/machine/include/syna.inc
```bitbake
#/*******************************************************************************
#*
#*             Copyright 2020, Beechwoods Software, Inc.
#*
#*******************************************************************************/

include conf/machine/include/syna-tiny.inc

# Synaptics BSP default providers
PREFERRED_PROVIDER_virtual/egl ?= "mesa"
PREFERRED_PROVIDER_virtual/libgles1 ?= "mesa"
PREFERRED_PROVIDER_virtual/libgles2 ?= "mesa"
PREFERRED_PROVIDER_virtual/mesa ?= "mesa"
PREFERRED_PROVIDER_virtual/libpvr-dri-support ?= "synasdk-gpu-pvr"
PREFERRED_PROVIDER_virtual/libgles1-pvr ?= "synasdk-gpu-pvr"
PREFERRED_PROVIDER_virtual/libgles2-pvr ?= "synasdk-gpu-pvr"
PREFERRED_PROVIDER_virtual/libpvr-scope-srv ?= "synasdk-gpu-pvr"
PREFERRED_PROVIDER_virtual/pvr-fw ?= "synasdk-gpu-pvr"
MACHINE_EXTRA_RRECOMMENDS += "synasdk-gpu-pvr"
MACHINE_ESSENTIAL_EXTRA_RDEPENDS += "kernel-devicetree"
```

## conf/machine/sl1620spi.conf
```bitbake
#@TYPE: Machine
#@NAME: sl1620spi
#@DESCRIPTION: Machine configuration for the SL1620 SoC

require conf/machine/include/arm/armv8-2a/tune-cortexa55.inc

include conf/machine/include/syna-tiny.inc
include conf/machine/include/syna-sdk.inc

IMAGE_CLASSES:remove = "image_synaimg"
IMAGE_CLASSES += "image_synaspiimg"
IMAGE_FSTYPES = "synaspiimg"

MACHINEOVERRIDES =. "myna2:"

SYNA_SDK_CONFIG_NAME ?= "sl1620_spi_${DISTRO_CONFIG}_aarch64_rdk"
SYNA_SDK_CONFIG_FILE ?= "${SYNA_SDK_CONFIG_NAME}_defconfig"
SYNA_SDK_PT_FILE = "spi.pt"
SYNA_SDK_FLASH_TYPE_CFG_FILE = "flash_type.cfg"
SYNA_SDK_FASTLOGO_IMG = ""
SYNA_KERNEL_CONFIG_FILE ?= "myna2_sizelimit_defconfig"
SYNA_KERNEL_DTS_FILE ?= "synaptics/myna2-rdk.dtb"

PREFERRED_VERSION_linux-syna:sl1620spi = "6.12.62"
PREFERRED_VERSION_linux-firmware-syna:sl1620spi = "6.12.62"

PREFERRED_PROVIDER_u-boot-fw-utils:sl1620spi= "libubootenv"

BBMULTICONFIG = "initramfscfg"
INITRAMFS_MULTICONFIG = "initramfscfg"
INITRAMFS_DEPLOY_DIR_IMAGE = "${TOPDIR}/tmp-initramfscfg/deploy/images/${MACHINE}"
```

## conf/machine/sl1640spi.conf
```bitbake
#@TYPE: Machine
#@NAME: sl1640spi
#@DESCRIPTION: Machine configuration for the SL1640 SoC

require conf/machine/include/arm/armv8-2a/tune-cortexa55.inc

include conf/machine/include/syna-tiny.inc
include conf/machine/include/syna-sdk.inc

IMAGE_CLASSES:remove = "image_synaimg"
IMAGE_CLASSES += "image_synaspiimg"
IMAGE_FSTYPES = "synaspiimg"

MACHINEOVERRIDES =. "platypus:"

SYNA_SDK_CONFIG_NAME ?= "sl1640_spi_${DISTRO_CONFIG}_aarch64_rdk"
SYNA_SDK_CONFIG_FILE ?= "${SYNA_SDK_CONFIG_NAME}_defconfig"
SYNA_SDK_PT_FILE = "spi.pt"
SYNA_SDK_FLASH_TYPE_CFG_FILE = "flash_type.cfg"
SYNA_SDK_FASTLOGO_IMG = ""
SYNA_KERNEL_CONFIG_FILE ?= "platypus_defconfig"
SYNA_KERNEL_DTS_FILE ?= "synaptics/platypus-rdk.dtb"

PREFERRED_VERSION_linux-syna:sl1640spi = "5.15.140"
PREFERRED_VERSION_linux-firmware-syna:sl1640spi = "5.15.140"

PREFERRED_PROVIDER_virtual/bootloader:sl1640spi = "syna-u-boot"

PREFERRED_PROVIDER_u-boot-fw-utils:sl1640spi= "libubootenv"
```

## conf/machine/sl1680.conf
```bitbake
#@TYPE: Machine
#@NAME: sl1680
#@DESCRIPTION: Machine configuration for the SL1680 SoC

require conf/machine/include/arm/armv8a/tune-cortexa73.inc

include conf/machine/include/syna.inc
include conf/machine/include/syna-sdk.inc

MACHINEOVERRIDES =. "dolphin:"

SYNA_SDK_CONFIG_NAME ?= "sl1680_${DISTRO_CONFIG}_aarch64_rdk"
SYNA_SDK_CONFIG_FILE ?= "${SYNA_SDK_CONFIG_NAME}_defconfig"
SYNA_KERNEL_CONFIG_FILE ?= "dolphin_defconfig"
SYNA_KERNEL_DTS_FILE ?= "synaptics/dolphin-rdk.dtb"
SYNA_KERNEL_DTBO_FILE ?= "synaptics/dolphin-csi0-with-expander.dtbo \
                          synaptics/dolphin-csi1-without-expander.dtbo \
                          synaptics/dolphin-bothcsi-without-expander.dtbo \
                          synaptics/dolphin-csi0-with-expander-csi1-without-expander.dtbo \
                          synaptics/dolphin-csi0-with-expander-dewarp-imx415.dtbo \
                          synaptics/dolphin-csi0-with-expander-dewarp-imx258.dtbo \
                          synaptics/dolphin-haier-panel-overlay.dtbo \
                          synaptics/dolphin-ws-panel-overlay.dtbo \
                          synaptics/dolphin-ws-1080p-panel-overlay.dtbo \
                          synaptics/dolphin-spi2-overlay.dtbo"

# WPE buffer size for media (important for youtube in 4K)
# 30MB for 1GB DRAM systems, 90MB for 2GB DRAM systems
SYNA_MEDIASOURCE_VIDEO_BUFFER_SIZE = "90"
# WPE RAM size limits, 192/200 for 1GB DRAM systems, 320/340 for 2GB DRAM systems
# (important to prevent memory pressure)
SYNA_WPE_RAM_SIZE = "320"
SYNA_WPE_WEB_PROCESS_RAM_SIZE = "340"

PREFERRED_VERSION_linux-syna:sl1680 = "5.15.140"
PREFERRED_VERSION_linux-firmware-syna:sl1680 = "5.15.140"

PREFERRED_PROVIDER_virtual/bootloader:sl1680 = "syna-u-boot"

PREFERRED_PROVIDER_u-boot-fw-utils:sl1680= "libubootenv"
```

## conf/machine/sl1680spi.conf
```bitbake
#@TYPE: Machine
#@NAME: sl1680spi
#@DESCRIPTION: Machine configuration for the SL1680 SoC

require conf/machine/include/arm/armv8a/tune-cortexa73.inc

include conf/machine/include/syna-tiny.inc
include conf/machine/include/syna-sdk.inc

IMAGE_CLASSES:remove = "image_synaimg"
IMAGE_CLASSES += "image_synaspiimg"
IMAGE_FSTYPES = "synaspiimg"

MACHINEOVERRIDES =. "dolphin:"

SYNA_SDK_CONFIG_NAME ?= "sl1680_spi_${DISTRO_CONFIG}_aarch64_rdk"
SYNA_SDK_CONFIG_FILE ?= "${SYNA_SDK_CONFIG_NAME}_defconfig"
SYNA_SDK_PT_FILE = "spi.pt"
SYNA_SDK_FLASH_TYPE_CFG_FILE = "flash_type.cfg"
SYNA_SDK_FASTLOGO_IMG = ""
UBOOT_MACHINE ?= "dolphin_spi_suboot_defconfig"
UBOOT_DTS_FILE ?= "dolphin-rdk.dtb"
SYNA_KERNEL_CONFIG_FILE ?= "dolphin_sizelimit_defconfig"
SYNA_KERNEL_DTS_FILE ?= "synaptics/dolphin-rdk.dtb"

PREFERRED_VERSION_linux-syna:sl1680spi = "6.12.62"
PREFERRED_VERSION_linux-firmware-syna:sl1680spi = "6.12.62"

PREFERRED_PROVIDER_u-boot-fw-utils:sl1680spi= "libubootenv"

BBMULTICONFIG = "initramfscfg"
INITRAMFS_MULTICONFIG = "initramfscfg"
INITRAMFS_DEPLOY_DIR_IMAGE = "${TOPDIR}/tmp-initramfscfg/deploy/images/${MACHINE}"
```

## conf/machine/sl2611nand.conf
```bitbake
#@TYPE: Machine
#@NAME: sl2611nand
#@DESCRIPTION: Machine configuration for the SL2611 SoC

require conf/machine/include/arm/armv8-2a/tune-cortexa55.inc

include conf/machine/include/syna-tiny.inc
include conf/machine/include/syna-sdk.inc

MACHINEOVERRIDES =. "sl2611:klamath:"

IMAGE_CLASSES:remove = "image_synaimg"
IMAGE_CLASSES += "image_synanandimg"
IMAGE_FSTYPES = "synanandimg"

SYNA_SDK_CONFIG_NAME ?= "sl2611_nand_${DISTRO_CONFIG}_aarch64_rdk"
SYNA_SDK_CONFIG_FILE ?= "${SYNA_SDK_CONFIG_NAME}_defconfig"
SYNA_SDK_PT_FILE = "nand.pt"
SYNA_SDK_FLASH_TYPE_CFG_FILE = "flash_type.cfg"
SYNA_SDK_FASTLOGO_IMG = ""
SYNA_KERNEL_CONFIG_FILE ?= "sl261x_defconfig"
SYNA_KERNEL_DTS_FILE ?= "synaptics/sl2611-nand-rdk.dtb"
SYNA_KERNEL_DTBO_FILE ?= "synaptics/sl261x-nand-overlay.dtbo"

# WPE buffer size for media (important for youtube in 4K)
# 30MB for 1GB DRAM systems, 90MB for 2GB DRAM systems
SYNA_MEDIASOURCE_VIDEO_BUFFER_SIZE = "90"
# WPE RAM size limits, 192/200 for 1GB DRAM systems, 320/340 for 2GB DRAM systems
# (important to prevent memory pressure)
SYNA_WPE_RAM_SIZE = "320"
SYNA_WPE_WEB_PROCESS_RAM_SIZE = "340"

PREFERRED_VERSION_linux-syna:sl2611nand = "6.12.62"
PREFERRED_VERSION_linux-firmware-syna:sl2611nand = "6.12.62"

PREFERRED_PROVIDER_u-boot-fw-utils:sl2611nand= "libubootenv"

#Remove packages to reduce rootfs size to fit small disk
GLIBC_GENERATE_LOCALES = ""
IMAGE_LINGUAS = "en-us"
IMAGE_FEATURES:remove:sl2611nand = "package-management ssh-server-dropbear"
DISTORO_FEATURES:sl2611nand = "pci ipv4 ipv6 usbhost usbgadget wifi acl alsa debuginfod ext2 pcmcia xattr nfs zeroconf vfat seccomp"
IMAGE_INSTALL:remove:sl2611nand = "packagegroup-core-tools-debug packagegroup-core-ssh-openssh gdbserver curl v4l-utils alsa-utils synasdk-syna-settings-framework wget vim wlan-connect ethtool syna-wifi-tools hostapd iptables protobuf libdrm-tests opensc brcm-patchram-plus synasdk-brcm-bt-start libgpiod libgpiod-tools iperf2 iperf3 net-tools tcpdump pciutils iputils zip networkmanager networkmanager-nmcli modemmanager evtest bridge-utils bluealsa i2c-tools ${GST_PACKAGES} swupdate swupdate-client swupdate-progress swupdate-tools swupdate-tools-hawkbit swupdate-tools-ipc swu-conf openssh openssh-sshd openssh-scp util-linux-lsblk util-linux udev udev-extraconf chrony rescue-support"
#IMAGE_INSTALL:remove:sl2611nand += " android-tools android-tools-adbd"
PACKAGE_EXCLUDE += " util-linux util-linux-look util-linux-rename util-linux-script util-linux-scriptlive util-linux-ul util-linux-waitpid util-linux-wdctl util-linux-whereis util-linux-write"
```
